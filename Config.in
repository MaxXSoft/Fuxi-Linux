## Config.in
```kconfig
source "$BR2_EXTERNAL_FUXI_PATH/package/fuxi-bootstub/Config.in"
source "$BR2_EXTERNAL_FUXI_PATH/package/fuxi-smoke/Config.in"
```

## configs/fuxi_defconfig
```kconfig
BR2_riscv=y
BR2_riscv_custom=y
BR2_RISCV_ISA_RVM=y
BR2_RISCV_ISA_RVA=y
BR2_RISCV_ISA_RVC=y
BR2_RISCV_32=y
BR2_RISCV_ABI_ILP32=y
BR2_TOOLCHAIN_BUILDROOT_MUSL=y
BR2_KERNEL_HEADERS_AS_KERNEL=y
BR2_PACKAGE_HOST_LINUX_HEADERS_CUSTOM_7_2=y
BR2_STATIC_LIBS=y
BR2_TARGET_OPTIMIZATION="-Os"
BR2_GLOBAL_PATCH_DIR="$(BR2_EXTERNAL_FUXI_PATH)/board/fuxi/patches"
BR2_DOWNLOAD_FORCE_CHECK_HASHES=y
BR2_REPRODUCIBLE=y
BR2_TARGET_GENERIC_HOSTNAME="fuxi"
BR2_TARGET_GENERIC_ISSUE="Fuxi RV32IMAC Linux"
BR2_INIT_NONE=y
# BR2_TARGET_GENERIC_GETTY is not set
# BR2_TARGET_GENERIC_REMOUNT_ROOTFS_RW is not set
BR2_ROOTFS_OVERLAY="$(BR2_EXTERNAL_FUXI_PATH)/board/fuxi/rootfs-overlay"
BR2_LINUX_KERNEL=y
BR2_LINUX_KERNEL_CUSTOM_TARBALL=y
BR2_LINUX_KERNEL_CUSTOM_TARBALL_LOCATION="https://github.com/torvalds/linux/archive/e767a4ea70a3992c37ed604157d32f0dfbf9b1e3/linux-e767a4ea70a3992c37ed604157d32f0dfbf9b1e3.tar.gz"
BR2_LINUX_KERNEL_USE_CUSTOM_CONFIG=y
BR2_LINUX_KERNEL_CUSTOM_CONFIG_FILE="$(BR2_EXTERNAL_FUXI_PATH)/board/fuxi/linux.config"
BR2_LINUX_KERNEL_IMAGE=y
BR2_LINUX_KERNEL_DTS_SUPPORT=y
BR2_LINUX_KERNEL_DTB_KEEP_DIRNAME=y
BR2_LINUX_KERNEL_CUSTOM_DTS_DIR="$(BR2_EXTERNAL_FUXI_PATH)/board/fuxi/dts"
BR2_PACKAGE_BUSYBOX_CONFIG="$(BR2_EXTERNAL_FUXI_PATH)/board/fuxi/busybox.config"
BR2_TARGET_ROOTFS_INITRAMFS=y
# BR2_TARGET_ROOTFS_TAR is not set
BR2_TARGET_OPENSBI=y
BR2_TARGET_OPENSBI_CUSTOM_TARBALL=y
BR2_TARGET_OPENSBI_CUSTOM_TARBALL_LOCATION="https://github.com/riscv-software-src/opensbi/archive/6ad246a1494807ee91e36ffcf60e4c30bb309d45/opensbi-6ad246a1494807ee91e36ffcf60e4c30bb309d45.tar.gz"
BR2_TARGET_OPENSBI_PLAT="generic"
# BR2_TARGET_OPENSBI_INSTALL_DYNAMIC_IMG is not set
BR2_TARGET_OPENSBI_INSTALL_JUMP_IMG=y
BR2_TARGET_OPENSBI_ADDITIONAL_VARIABLES="PLATFORM_RISCV_XLEN=32 PLATFORM_RISCV_ISA=rv32imac_zicsr_zifencei PLATFORM_RISCV_ABI=ilp32 FW_TEXT_START=0x80000000 FW_JUMP_ADDR=0x80400000 FW_JUMP_FDT_ADDR=0x87e00000 FW_DYNAMIC=n FW_PAYLOAD=n BUILD_INFO=n"
BR2_PACKAGE_FUXI_BOOTSTUB=y
BR2_PACKAGE_FUXI_SMOKE=y
```

## package/fuxi-bootstub/Config.in
```kconfig
config BR2_PACKAGE_FUXI_BOOTSTUB
	bool "Fuxi simulation reset stub"
	depends on BR2_RISCV_32
	help
	  Build the ROM reset stub that enters OpenSBI with hart 0 and
	  the Fuxi simulation device tree. This is a simulation image,
	  not a userspace program.
```

## package/fuxi-smoke/Config.in
```kconfig
config BR2_PACKAGE_FUXI_SMOKE
	bool "Fuxi Linux userspace smoke checks"
	depends on BR2_RISCV_32 && BR2_USE_MMU
	help
	  Verify fork/exec, copy-on-write, page protection, scalar
	  misaligned accesses, and timer wakeup in the booted guest.
```
